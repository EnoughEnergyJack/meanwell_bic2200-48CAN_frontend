VERSION ""

NS_ :

BS_:

BU_:
VAL_TABLE_ COMMANDS 320 "BIDIRECTIONAL_CONFIG" 304 "REVERSE_IOUT_SET" 288 "REVERSE_VOUT_SET" 256 "DIRECTION_CTRL" 194 "SYSTEM_CONFIG" 193 "SYSTEM_STATUS" 192 "SCALING_FACTOR" 113 "READ_FAN_SPEED2" 112 "READ_FAN_SPEED1" 97 "READ_IOUT" 96 "READ_VOUT" 80 "READ_VIN" 64 "FAULT_STATUS" 48 "IOUT_SET" 32 "VOUT_SET" 0 "OPERATION" ;

BO_ 2148270592 Meanwell_Return_Data_00: 8 Vector__XXX
 SG_ COMMAND : 0|16@1+ (1,0) [0|0] "" Vector__XXX
 SG_ RETURN_DATA_0 : 16|16@1- (0.01,0) [0|0] "" Vector__XXX

BO_ 2148270848 Meanwell_ReadWrite_00: 4 Vector__XXX
 SG_ WRITE_DATA : 16|16@1- (1,0) [0|0] "" Vector__XXX
 SG_ COMMAND : 0|16@1+ (1,0) [0|0] "" Vector__XXX

BA_DEF_  "BusType" STRING ;
BA_DEF_DEF_  "BusType" "CAN";
VAL_ 2148270592 COMMAND 320 "BIDIRECTIONAL_CONFIG" 304 "REVERSE_IOUT_SET" 288 "REVERSE_VOUT_SET" 256 "DIRECTION_CTRL" 194 "SYSTEM_CONFIG" 193 "SYSTEM_STATUS" 192 "SCALING_FACTOR" 113 "READ_FAN_SPEED2" 112 "READ_FAN_SPEED1" 97 "READ_IOUT" 96 "READ_VOUT" 80 "READ_VIN" 64 "FAULT_STATUS" 48 "IOUT_SET" 32 "VOUT_SET" 0 "OPERATION" ;
VAL_ 2148270848 COMMAND 320 "BIDIRECTIONAL_CONFIG" 304 "REVERSE_IOUT_SET" 288 "REVERSE_VOUT_SET" 256 "DIRECTION_CTRL" 194 "SYSTEM_CONFIG" 193 "SYSTEM_STATUS" 192 "SCALING_FACTOR" 113 "READ_FAN_SPEED2" 112 "READ_FAN_SPEED1" 97 "READ_IOUT" 96 "READ_VOUT" 80 "READ_VIN" 64 "FAULT_STATUS" 48 "IOUT_SET" 32 "VOUT_SET" 0 "OPERATION" ;
